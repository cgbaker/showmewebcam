## Config.in
```kconfig
source "$BR2_EXTERNAL_PICAM_PATH/package/piwebcam/Config.in"
source "$BR2_EXTERNAL_PICAM_PATH/package/soft-hwclock/Config.in"
source "$BR2_EXTERNAL_PICAM_PATH/package/camera-control/Config.in"
source "$BR2_EXTERNAL_PICAM_PATH/package/pi-mqtt-gpio/Config.in"
```

## package/pi-mqtt-gpio-svc/Config.in
```kconfig
config BR2_PACKAGE_PI_MQTT_GPIO
	bool "Raspberry Pi MQTT-GPIO Systemd service"
	help
	  Expose the Raspberry Pi GPIO pins (and/or external IO modules such
	  as.
```

## package/pi-mqtt-gpio/Config.in
```kconfig
config BR2_PACKAGE_PIMQTTGPIO
	bool "Raspberry Pi MQTT-GPIO Publisher"
	select BR2_PACKAGE_PYTHON_PAHO_MQTT # runtime
	select BR2_PACKAGE_PYTHON_PYYAML # runtime
	help
	  Expose the Raspberry Pi GPIO pins (and/or external IO modules such
	  as.
```

## package/python-pi-mqtt-gpio/Config.in
```kconfig
config BR2_PACKAGE_PYTHON_PI_MQTT_GPIO
	bool "python-pi-mqtt-gpio"
	help
	  https://github.com/hpeyerl/pi-mqtt-gpio
```
